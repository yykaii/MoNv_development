/**==================================================================================================================
 **【文件名称】  main.c
 **【功能测试】  按键控制LED_使用扫描方法检测按键状态
 **==================================================================================================================
 **【实验平台】  STM32F103 + KEIL5.27 
 **
 **【实验操作】  USB线，插到开发板CMSIS-DAP接口上;
 **              因使用的是板载的LED，因而无需其它接线及器材;
 **              点击软件左上角的编译，编译无错后，点击LOAD，即可烧录至开发板;
 **
 **【划 重 点】  KEY1，闲时低电平，按下时，是高电平
 **              KEY2和KEY3，闲时高电平，按下时是低电平
 **
 **【更新记录】  2022-01-25  完善代码结构、注释
 **              2021-12-03  创建
 **
 **【备注说明】  版权归魔女科技所有，请勿商用，谢谢！ 
 **              https://demoboard.taobao.com 
====================================================================================================================*/
#include <stm32f10x.h>               // 头文件引用(标准库); 内核、芯片外设....;(stm32f10x.conf.h, 对标准库头文件进行调用)     
#include "stm32f10x_conf.h"          // 头文件引用(标准库); 内核、芯片外设....;(stm32f10x.conf.h, 对标准库头文件进行调用) 
#include "bsp_led.h"                 // LED代码文件
#include "bsp_key.h"                 // KEY代码文件

static void delay_ms(u32 ms)
{
    ms=ms*6500;                  
    for(u32 i=0; i<ms; i++);      // 72MHz系统时钟下，多少个空循环约耗时1ms
}

int main(void)                       // 主函数, 整个工程的用户代码起始点
{   
    delay_ms(200);
    Led_Init();                      // LED初始化
    LED_BLUE_ON ;                    // 点亮蓝灯
    LED_RED_ON;                      // 点亮红灯  

    Key_Init();                      // KEY初始化        

    while(1)                         // while函数死循环，不能让main函数运行结束，否则会产生硬件错误
    { 
        // 按键1检测
        if(Key_Scan(KEY_1_GPIO, KEY_1_PIN, 1))    // 参数说明：GPIO端口，Pin引脚编号, 按下时的电平 
        {
            LED_BLUE_TOGGLE;                      // 当扫描到KEY1单击，蓝色LED反转一次
        }
        // 按键2检测
        if(Key_Scan(KEY_2_GPIO, KEY_2_PIN, 0))
        {
            LED_RED_TOGGLE;                       // 当扫描到KEY2单击，红色LED反转一次
        }
        // 按键3检测
        if(Key_Scan(KEY_3_GPIO, KEY_3_PIN, 0)) 
        {                
            LED_RED_TOGGLE;                       // 当扫描到KEY3单击，蓝色LED和红色反转一次
            LED_BLUE_TOGGLE;                      
        }                         
    }          
}




