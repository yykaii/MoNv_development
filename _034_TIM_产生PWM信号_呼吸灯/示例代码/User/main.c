/*==================================================================================================================
 *【文件名称】  main.c
 *【功    能】  PWM信号_呼吸灯
 ===================================================================================================================
 *【实验说明】  1-板载的LED灯，所用引脚蓝灯_PB2, 红灯_PC5, 是没有TIM功能的
 *              2-挑一个有TIM功能的引脚，如PB1(TIM3-CH4), 用杜邦线接到LED灯所用引脚上，如PB1->PB2(蓝灯)
 *
 *【函数简介】  为简化及统一代码，已封装成２个对外函数，可完成各种基本操作
 **             TIM_PwmInit();              // 配置引脚、TIM时基、PWM周期
 *              TIM_SetCCR();               // 设置脉宽
 *
 *【更新记录】  2021-05-16  创建
 *              2022-04-21  修改各文件名称、函数名称
 *
 *【备注说明】  版权归魔女科技所有，请勿商用，谢谢！
 *              https://demoboard.taobao.com
===================================================================================================================*/
#include <stm32f10x.h>
#include "stm32f10x_conf.h"                  // 头文件引用(标准库); 内核、芯片外设....；(stm32f10x.conf.h, 对标准库头文件进行调用)  
#include "bsp_led.h"                         // LED指示灯
#include "bsp_key.h"                         // 按键
#include "bsp_usart.h"                       // USART1、2、3，UART4、5
#include "bsp_pwm.h"



static uint8_t  fx   = 0;
static uint16_t i    = 0;



static void delay_ms(uint32_t ms)                     // 定义一个ms延时函数，减少移植时对外部文件依赖;
{
    ms = ms * 6500;
    for (uint32_t i = 0; i < ms; i++);                // 72MHz系统时钟下，大约6500个空循环耗时1ms
}



int main(void)
{
    USART1_Init(115200);                                     // 初始化USART1作为调试信息输出

    Led_Init();                                              // LED 初始化
    LED_RED_ON ;
    LED_BLUE_ON ;

    // 初始化PWM引脚、时基配置
    TIM_PwmInit(GPIOB, GPIO_Pin_1, TIM3, 4, 72, 1000, 1000);    // PB1引脚，TIM3_CH4, 1脉冲时长1us(时钟÷分频值 = 72000000÷72), PWM信号周期: 1ms(即1us x 1000), 初始脉宽1ms(即占空比的时长）


    while (1)                                                // while函数死循环，不能让main函数运行结束，否则会产生硬件错误
    {
        if (fx == 0)
        {
            i++;
            if (i == 999)
            {
                fx = 1;
            }
        }
        else
        {
            i--;
            if (i == 0)
            {
                fx = 0;
            }
        }
        TIM_SetCCR(TIM3, 4, i);                             // 改变脉宽输出：
        delay_ms(3);                                        // 稍作延时; 影响灯光变化速度
    }
}






