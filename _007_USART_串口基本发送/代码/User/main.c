/**==================================================================================================================
 **【文件名称】  main.c
 **【功能测试】  串口基础发送
 **==================================================================================================================
 **【实验平台】  STM32F103 + KEIL5.27 + ESP8266
 **
 **【实验操作】  1_USB线插到板上的CMSIS DAP接口，即可完成供电、烧录、串口通信的接线;
 **              2_打开任意一串口软件，本示例中使用的是火哥串口软件;
 **              3_串口软件参数设置：115200-N-8-1, 选择相应的串口端口，并点击“打开串口”
 **
 **【划 重 点】  1_引脚初始化时，注意引脚的工作模式
 **              2_USART1(PA9,PA10), USART2(PA2,PA3), USART3(PB10,PB11), UART4(PC10,PC11), UART5(PC12,PD2)
 **
 **【更新记录】  2021-12-26  完善代码结构、注释
 **              2021-12-03  创建
 **
 **【备注说明】  版权归魔女科技所有，请勿商用，谢谢！
 **              https://demoboard.taobao.com
====================================================================================================================*/
#include <stm32f10x.h>            // 头文件引用(标准库); 内核、芯片外设....;(stm32f10x.conf.h, 对标准库头文件进行调用)     
#include "stm32f10x_conf.h"       // 头文件引用(标准库); 内核、芯片外设....;(stm32f10x.conf.h, 对标准库头文件进行调用) 
#include "bsp_led.h"              // LED指示灯
#include "bsp_key.h"              // 按键支持文件
#include "bsp_usart.h"            // 串口支持文件



static void delay_ms(uint32_t ms)                     // 定义一个ms延时函数，减少移植时对外部文件依赖;
{
    ms = ms * 6500;
    for (uint32_t i = 0; i < ms; i++);                // 72MHz系统时钟下，大约6500个空循环耗时1ms
}



int main(void)                                        // 主函数, 整个工程的用户代码起始点
{
    NVIC_PriorityGroupConfig(NVIC_PriorityGroup_2);   // 中断分组，组2:抢占级0~3,子优先级0~3 ; 全局只设置一次，尽量放在显眼的地方
    USART1_Init(115200);                              // 串口1初始化; 用于与串口软件通信，方便代码调试; USART1(115200-N-8-1), 且工程已把printf重定向至USART1输出

    Led_Init();                                       // LED 初始化
    LED_BLUE_ON ;                                     // 点亮蓝灯
    LED_RED_ON;                                       // 点亮红灯

    Key_Init();                                       // 按键初始化

    // 示例1：USART最基础的发送原理
    char *charTemp = "测试1: 发送寄存器直接输出.\r\n"; // 待输出的字符串数据
    while (*charTemp)                                 // 判断字符串结束符号：'\0',即0
    {
        while ((USART1->SR & (1 << 7)) == 0);         // 等待发送寄存器为空; 这种方式虽然清晰，但最大的缺点就在这里，115200波特率下，每发送一字节，要等待87us
        USART1->DR = *charTemp++ ;                    // 把数据复制到数据寄存器(发送寄存器)
    }

    // 示例2: 重定向到printf输出
    printf("测试2：printf输出.\r\n");                 // 使用printf函数前，需要做两个事情，1_引用stdio.h文件，2_把printf的输出重定向到USART, 不然会直接卡死。

    while (1)                                         // while函数死循环，不能让main函数运行结束，否则会产生硬件错误
    {
        delay_ms(500);                                // 间隔延时
        LED_RED_TOGGLE;
    }
}




